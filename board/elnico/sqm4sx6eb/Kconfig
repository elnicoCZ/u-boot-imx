## board/elnico/sqm4sx6eb/Kconfig
```kconfig
if TARGET_SQM4SX6EB

config SYS_BOARD
	default "sqm4sx6eb"

config SYS_VENDOR
	default "elnico"

config SYS_CONFIG_NAME
	default "sqm4sx6eb"

endif
```

## board/elnico/sqm4sx6uni/Kconfig
```kconfig
if TARGET_SQM4SX6UNI

config SYS_BOARD
	default "sqm4sx6uni"

config SYS_VENDOR
	default "elnico"

config SYS_CONFIG_NAME
	default "sqm4sx6uni"

endif
```

## configs/sqm4sx6eb_nand_defconfig
```kconfig
CONFIG_ARM=y
CONFIG_ARCH_MX6=y
CONFIG_TARGET_SQM4SX6EB=y
CONFIG_SYS_EXTRA_OPTIONS="IMX_CONFIG=board/elnico/sqm4sx6eb/sqm4sx6eb.cfg,SYS_BOOT_NAND"
CONFIG_CMD_GPIO=y
```

## configs/sqm4sx6uni_defconfig
```kconfig
CONFIG_ARM=y
CONFIG_ARCH_MX6=y
CONFIG_TARGET_SQM4SX6UNI=y
CONFIG_SYS_EXTRA_OPTIONS="IMX_CONFIG=board/elnico/sqm4sx6/sqm4sx6.cfg"
```
